#define BLYNK_PRINT Serial
#include <ESP8266_Lib.h>
#include <BlynkSimpleShieldEsp8266.h>
char auth[] = "XXXXXXXXXXXXXXXXXXXXXXX";//Unique auth code generated by BLynk
char ssid[] = "XXXXXXXXXXXXXXX"; //enter wifi ssid
char pass[] = "XXXXXXXXXXXXXXX"; //enter wifi password
#define EspSerial Serial
#define ESP8266_BAUD 115200
ESP8266 wifi(&EspSerial);
BlynkTimer timer;
#include <NewPing.h>
#define tp_1 3
#define ep_1 2
NewPing sonar1(tp_1, ep_1);//right most sensor(pins facing forward)-sensor facing towards RHS
#define tp_2 5
#define ep_2 6
NewPing sonar2(tp_2, ep_2);//second from right-sensor facing front
#define tp_3 8
#define ep_3 9
NewPing sonar3(tp_3, ep_3);//second from left-sensor facing bottom
#define tp_4 11
#define ep_4 12
NewPing sonar4(tp_4, ep_4);//last from left-sensor facing LHS
int threshT = 38;
int threshold = 600;
void myTimerEvent()//To check level of surrounding light, and send an alert if its too bright
{
 int ldrValue = analogRead(A3);//To check the value read by the light dependent sensor
 Blynk.virtualWrite(V1, ldrValue);
 if (ldrValue < threshold)// To check if the reading of the LDR crosses the preset light 
 {
 Blynk.virtualWrite(V3, "https://maker.ifttt.com/trigger/insert_your_Iftt_event_name/with/key/insert_your_auth_token_here");//Trigger for email
 }
}
void myTimerEvent1() //To check the temperature of the surroundings, and send an alert if its too bright
{
 int valT = analogRead(A0);//To store the value read by the sensor on the stick
 int temp = valT * 0.488;//To convert the raw temperature value to degrees
 Blynk.virtualWrite(V6, temp);
 if (temp > threshT) //To check if the temperature crosses the threshold that is preset
 {
 Blynk.virtualWrite(V7, "https://maker.ifttt.com/trigger/insert_your_Iftt_event_name/with/key/insert_your_auth_token_here");//Trigger for email
 }
}
BLYNK_WRITE(V8) //Sounds alarm on stick if a button on an app is pressed, to help locate the stick within the limits of the house
{
 int lx = param.asInt();// To read and store the condition of the button on the app
 if (lx == 1)
 {
 digitalWrite(A1, HIGH);
 }
 else
 {
 digitalWrite(A1, LOW);
 }
}
WidgetMap mymap(V2);
float lat;//To store latitude
float lon;//To store longitude
BLYNK_WRITE(V30)// GPS to locate the stick if misplaced outside(on blynk)
{
 lat = param[0].asFloat();//To store the latitudnal position of the stick 
 lon = param[1].asFloat();//To store longitudnal position of walking stick
}
void setup()
{
 pinMode(A1, OUTPUT);
 Serial.begin(115200);
 EspSerial.begin(ESP8266_BAUD);
 delay(1000);
 Blynk.begin(auth, wifi, ssid, pass);
 timer.setInterval(5000L, myTimerEvent);
 timer.setInterval(5000L, myTimerEvent1);
 float index = 0;
 mymap.location(index, lat, lon, "value");
 Serial.begin(115200);
 pinMode(A1, OUTPUT);
 pinMode(A5, OUTPUT);

}
void loop()
{
 Blynk.run();
 timer.run();

float val1=sonar1.ping_cm();
 delay(100);
 Serial.print("Distance1=");
 Serial.print(val1);
 Serial.println();
 float val2=sonar2.ping_cm();
 delay(100);
 Serial.print("Distance2=");
 Serial.print(val2);
 Serial.println();
 float val3=sonar3.ping_cm();
 delay(100);
 Serial.print("Distance3=");
 Serial.print(val3);
 Serial.println();
 float val4=sonar4.ping_cm();
 delay(100);
 Serial.print("Distance4=");
 Serial.print(val4);
 Serial.println(); 
//Next sequence of code is to issue warnings as per detected distance from obstacles
 if(val1>=25&&val1<=50||val2>=50&&val2<=75)
 {
 digitalWrite(A1,HIGH);
 delay(20);
 digitalWrite(A1,LOW);
 delay(20);


 }
 else if(val1>=10&&val1<25||val2>=25&&val2<50)
 {
 digitalWrite(A1,HIGH);
 delay(5);
 digitalWrite(A1,LOW);
 delay(5);

 }
 else if(val1<10||val2<25)
 {
 digitalWrite(A1,HIGH);
 }
 else
 {
 digitalWrite(A1,LOW);
 }
 if(val4>=52&&val4<=50||val3>=25&&val3<=50){
 digitalWrite(A5,HIGH);
 delay(20);
 digitalWrite(A5,LOW);
 }
 else
 {
 digitalWrite(A5,HIGH);
 delay(5);
 digitalWrite(A5,LOW);
 delay(5);

 }
 if(val4<10||val3<10)
 {
 digitalWrite(A5,HIGH);
 delay(20);
 }
 else
 { 
 digitalWrite(A5,LOW);
  
 } 
delay(20);


 }
